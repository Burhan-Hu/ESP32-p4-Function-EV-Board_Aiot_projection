## components/audio/Kconfig
```kconfig
menu "Audio Configuration"

    config AUDIO_I2S_MCLK_GPIO
        int "I2S MCLK GPIO"
        default 13
        help
            GPIO number connected to ES8311 MCLK.

    config AUDIO_I2S_BCLK_GPIO
        int "I2S BCLK GPIO"
        default 12
        help
            GPIO number connected to ES8311 SCLK/BCLK.

    config AUDIO_I2S_WS_GPIO
        int "I2S WS/LRCK GPIO"
        default 10
        help
            GPIO number connected to ES8311 LRCK/WS.

    config AUDIO_I2S_DOUT_GPIO
        int "I2S DOUT GPIO (to ES8311 DAC)"
        default 9
        help
            GPIO number connected to ES8311 DSDIN (DAC data input).

    config AUDIO_I2S_DIN_GPIO
        int "I2S DIN GPIO (from ES8311 ADC)"
        default 11
        help
            GPIO number connected to ES8311 ASDOUT (ADC data output).

    config AUDIO_PA_CTRL_GPIO
        int "Power amplifier control GPIO"
        default 53
        help
            GPIO number used to enable the speaker amplifier. Set -1 to disable.

    config AUDIO_PLAYBACK_VOLUME
        int "Default playback volume"
        range 0 100
        default 60
        help
            Default output volume for ES8311 DAC.

    config AUDIO_MIC_GAIN
        int "Default microphone gain (dB)"
        range 0 42
        default 42
        help
            Default input gain for ES8311 ADC.

    config AUDIO_ENABLE_LOOPBACK_TEST
        bool "Enable audio loopback test task"
        default n
        help
            If enabled, a FreeRTOS task is started that records from the
            microphone and plays back through the speaker continuously.

    config AUDIO_ENABLE_RECORD_TEST
        bool "Enable audio record-only test task"
        default n
        depends on !AUDIO_ENABLE_LOOPBACK_TEST && !WAKE_WORD_ENABLED
        help
            If enabled, a FreeRTOS task records 3 seconds of audio from the
            microphone and prints the peak amplitude. Useful when no speaker
            is connected yet. Mutually exclusive with wake word detection.

endmenu
```

## components/cloud_api/Kconfig
```kconfig
menu "Cloud API Configuration"

    config CLOUD_API_USE_MOCK
        bool "Use mock cloud API (no network required)"
        default n
        help
            When enabled, ASR/VLM/TTS return fixed responses and a synthetic
            tone, so the interaction pipeline can be tested without real
            cloud accounts.

    config CLOUD_API_BAIDU_KEY
        string "Baidu API Key"
        default ""
        help
            Baidu AI Cloud API Key (from your Baidu application).

    config CLOUD_API_BAIDU_SECRET
        string "Baidu Secret Key"
        default ""
        help
            Baidu AI Cloud Secret Key (from your Baidu application).

    config CLOUD_API_BAIDU_CUID
        string "Baidu CUID"
        default "esp32p4_aiot_agent"
        help
            Unique device identifier for Baidu ASR/TTS APIs.

    config CLOUD_API_VOLCANO_KEY
        string "Volcano Engine API key"
        default ""
        help
            Volcano Engine (Ark) API key for VLM.

    config CLOUD_API_VOLCANO_ENDPOINT
        string "Volcano Engine endpoint"
        default "https://ark.cn-beijing.volces.com/api/v3"
        help
            Base URL for Volcano Engine Ark API. The code appends
            /chat/completions to this base URL internally.

    config CLOUD_API_VOLCANO_VLM_MODEL
        string "Volcano VLM model"
        default "doubao-vision-lite-32k"
        help
            Model name for visual question answering, e.g. doubao-vision-lite-32k.

    choice CLOUD_API_TTS_PROVIDER
        prompt "TTS provider"
        default CLOUD_API_TTS_PROVIDER_DOUBAO
        help
            Select which cloud TTS service to use for voice reminders.

        config CLOUD_API_TTS_PROVIDER_BAIDU
            bool "Baidu"

        config CLOUD_API_TTS_PROVIDER_DOUBAO
            bool "Doubao (Volcano Engine)"
    endchoice

    config CLOUD_API_DOUBAO_TTS_APPID
        string "Doubao TTS App ID"
        depends on CLOUD_API_TTS_PROVIDER_DOUBAO
        default ""
        help
            Doubao/Volcano Engine speech application ID.

    config CLOUD_API_DOUBAO_TTS_TOKEN
        string "Doubao TTS access token (API Key)"
        depends on CLOUD_API_TTS_PROVIDER_DOUBAO
        default ""
        help
            Doubao/Volcano Engine speech access token (the API Key shown in console).

    config CLOUD_API_DOUBAO_TTS_CLUSTER
        string "Doubao TTS cluster"
        depends on CLOUD_API_TTS_PROVIDER_DOUBAO
        default "volcano_tts"
        help
            Doubao TTS cluster, e.g. volcano_tts.

    config CLOUD_API_DOUBAO_TTS_VOICE
        string "Doubao TTS voice type"
        depends on CLOUD_API_TTS_PROVIDER_DOUBAO
        default "zh_female_sajiaonvyou_moon_bigtts"
        help
            Voice type, e.g. zh_female_sajiaonvyou_moon_bigtts.

    config CLOUD_API_DOUBAO_TTS_RATE
        int "Doubao TTS sample rate"
        depends on CLOUD_API_TTS_PROVIDER_DOUBAO
        default 16000
        range 8000 24000
        help
            Output PCM sample rate. 16000 matches the onboard audio pipeline.

    config CLOUD_API_VLM_HISTORY_MAX
        int "Max VLM conversation history turns"
        default 6
        range 0 20
        help
            Number of recent conversation turns to keep for VLM context.
            Each turn is a user message plus an assistant reply. Set 0 to
            disable context memory.

    config CLOUD_API_LLM_MAX_TOKENS
        int "Max LLM output tokens"
        default 200
        range 20 4096
        help
            Limit the number of tokens the cloud LLM returns. A smaller value
            keeps answers concise and prevents TTS responses from being cut
            off due to input length limits.

    config CLOUD_API_TTS_MAX_CHARS
        int "Max TTS input characters"
        default 200
        range 50 1000
        help
            Truncate long LLM answers before sending them to TTS. This avoids
            huge PCM buffers and long speech replies.

    config CLOUD_API_VOLCANO_TTS_VOLUME
        int "Volcano/Baidu TTS output volume scale (percent)"
        default 80
        range 0 200
        help
            Scale the PCM amplitude returned by TTS. 100 means no change,
            80 means 0.8x, 50 means half volume. Use 0 to mute.

endmenu
```

## components/human_detect/Kconfig
```kconfig
menu "Human Detection Configuration"

    config HUMAN_DETECT_INTERVAL_MS
        int "Human detection interval in milliseconds"
        default 250
        range 50 5000
        help
            Delay between two ESP-WHO pedestrian detections.

    config HUMAN_DETECT_TASK_STACK_SIZE
        int "Human detection task stack size"
        default 32768
        range 4096 65536
        help
            Stack size for the background detection task.

    config HUMAN_DETECT_TASK_PRIORITY
        int "Human detection task priority"
        default 4
        range 1 20
        help
            FreeRTOS task priority for local pedestrian detection.

    config HUMAN_DETECT_CONFIDENCE_THRESHOLD
        int "Pedestrian confidence threshold percent"
        default 55
        range 1 100
        help
            Best detection score must be at least this percent to count as a person.

    config HUMAN_DETECT_ENTER_CONFIRM_FRAMES
        int "Consecutive detected frames before present"
        default 1
        range 1 10
        help
            Debounce threshold before switching from absent to present.

    config HUMAN_DETECT_LEAVE_TIMEOUT_MS
        int "Person-left timeout in milliseconds"
        default 8000
        range 500 600000
        help
            LED turns off only after no person has been detected for this timeout.

    config HUMAN_DETECT_LEAVE_REMINDER_MS
        int "Person-left voice-reminder delay in milliseconds"
        default 60000
        range 1000 600000
        help
            If a registered reminder callback exists, it is fired once after the
            person has been absent for this duration.

    config HUMAN_DETECT_LED_AUTO_CONTROL
        bool "Automatically control LED by human presence"
        default y
        help
            If enabled, detected person turns the LED on and leave timeout turns it off.

    config HUMAN_DETECT_LOG_EACH_RESULT
        bool "Log every human detection result"
        default n
        help
            Enable verbose per-frame detection logs for board-level tuning.

endmenu
```

## components/led_controller/Kconfig
```kconfig
menu "LED Controller Configuration"

    config LED_CONTROLLER_GPIO
        int "LED PWM GPIO"
        default 21
        range -1 54
        help
            GPIO used to drive the LED or external LED driver PWM input.
            Set to -1 to compile the controller but disable physical output.
            GPIO20 is already used by the PIR sensor in this project.

    config LED_CONTROLLER_PWM_FREQ_HZ
        int "LED PWM frequency"
        default 5000
        range 100 40000
        help
            PWM frequency for a simple white LED or LED driver input.

    config LED_CONTROLLER_DEFAULT_BRIGHTNESS
        int "Default LED brightness percent"
        default 80
        range 0 100
        help
            Brightness used when led_turn_on() is called.

    config LED_CONTROLLER_ACTIVE_HIGH
        bool "LED is active high"
        default y
        help
            Disable this if the LED driver turns on when PWM duty is low.

endmenu
```

## components/pir/Kconfig
```kconfig
menu "PIR Sensor Configuration"

    config PIR_SENSOR_ENABLED
        bool "Enable PIR motion sensor"
        default y
        help
            Start a task that monitors the PIR sensor output pin and logs
            motion events. The pin can be selected below.

    config PIR_SENSOR_GPIO
        int "PIR sensor OUT GPIO number"
        depends on PIR_SENSOR_ENABLED
        default 20
        range 0 54
        help
            GPIO connected to the PIR sensor OUT signal.
            On ESP32-P4-Function-EV-Board J1 header, GPIO20 is pin 13.

    config PIR_SENSOR_TASK_STACK_SIZE
        int "PIR sensor task stack size"
        depends on PIR_SENSOR_ENABLED
        default 4096
        help
            Stack size for the PIR monitoring task.

endmenu
```

## components/ui/Kconfig
```kconfig
menu "Guardian UI"

config UI_MANAGER_DEMO_ENABLE
    bool "Enable Guardian video overlay demo flow"
    default y
    help
        Start a lightweight mock HUD flow after ui_manager_init().

config UI_MANAGER_USE_LVGL
    bool "Use LVGL overlay draw hook"
    default n
    help
        Keep this disabled until the display owner wires LVGL flush and input.
        The UI manager will still expose the same state and overlay APIs.

endmenu
```

## components/wake_word/Kconfig
```kconfig
menu "Wake Word Configuration"

    config WAKE_WORD_ENABLED
        bool "Enable WakeNet wake word detection task"
        default y
        help
            Start the WakeNet wake word detection task after audio initialization.
            The detected wake word can be selected in the ESP Speech Recognition
            menu (provided by esp-sr component).

    config WAKE_WORD_TASK_STACK_SIZE
        int "Wake word task stack size"
        default 8192
        help
            Stack size for the wake word detection task.

endmenu
```

## main/Kconfig.projbuild
```kconfig
menu "Example Configuration"

    config WIFI_CONN_SSID
        string "Wi-Fi SSID"
        default "your-ssid"
        help
            SSID (network name) to connect to.

    config WIFI_CONN_PASSWORD
        string "Wi-Fi Password"
        default "your-password"
        help
            Wi-Fi password (WPA or WPA2).

    config WIFI_CONN_MAX_RETRY
        int "Wi-Fi connection max retry"
        default 5
        range 1 20
        help
            Max retry times for Wi-Fi connection before reporting failure.

    config WIFI_CONN_FORCE_STA_MAC
        bool "Force STA MAC to P4 base MAC"
        default n
        help
            If enabled, the STA MAC address is overridden with the P4 base MAC.
            Leave disabled to let the ESP32-C6 co-processor use its own MAC.

    config EXAMPLE_USED_LDO_CHAN_ID
        int "example used LDO channel ID"
        default 3
        help
            Example used LDO channel ID, you may check datasheet to know more details.

    config EXAMPLE_USED_LDO_VOLTAGE_MV
        int "example used LDO voltage in mV"
        default 2500
        range 0 3300
        help
            Example used LDO voltage, in mV

    config EXAMPLE_CAM_PORT_ISP_MIPI
        bool
        default y

    choice EXAMPLE_MIPI_CSI_DISP_HRES
        bool "Set MIPI CSI horizontal resolution"
        default EXAMPLE_MIPI_CSI_HRES_1024

        config EXAMPLE_MIPI_CSI_HRES_800
            bool "800"
        config EXAMPLE_MIPI_CSI_HRES_1024
            bool "1024"
    endchoice

    config EXAMPLE_MIPI_CSI_DISP_HRES
        int
        default 800 if EXAMPLE_MIPI_CSI_HRES_800
        default 1024 if EXAMPLE_MIPI_CSI_HRES_1024

    choice EXAMPLE_MIPI_CSI_DISP_VRES
        bool "Set MIPI CSI vertical resolution"
        default EXAMPLE_MIPI_CSI_VRES_600

        config EXAMPLE_MIPI_CSI_VRES_600
            bool "600"
        config EXAMPLE_MIPI_CSI_VRES_640
            bool "640"
        config EXAMPLE_MIPI_CSI_VRES_800
            bool "800"
        config EXAMPLE_MIPI_CSI_VRES_1280
            bool "1280"
    endchoice

    config EXAMPLE_MIPI_CSI_DISP_VRES
        int
        default 600 if EXAMPLE_MIPI_CSI_VRES_600
        default 640 if EXAMPLE_MIPI_CSI_VRES_640
        default 800 if EXAMPLE_MIPI_CSI_VRES_800
        default 1280 if EXAMPLE_MIPI_CSI_VRES_1280
endmenu
```
