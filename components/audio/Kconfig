## sdkconfig.defaults.esp32p4
```kconfig
CONFIG_IDF_EXPERIMENTAL_FEATURES=y
CONFIG_SPIRAM=y
CONFIG_SPIRAM_SPEED_200M=y
CONFIG_SPIRAM_USE_MALLOC=y
CONFIG_ESP_WIFI_REMOTE_LIBRARY_HOSTED=y
CONFIG_SLAVE_IDF_TARGET_ESP32C6=y
CONFIG_ESP_HOSTED_CP_TARGET_ESP32C6=y
CONFIG_ESP_HOSTED_P4_DEV_BOARD_FUNC_BOARD=y
CONFIG_ESP_HOSTED_SDIO_HOST_INTERFACE=y
CONFIG_PARTITION_TABLE_CUSTOM=y
CONFIG_PARTITION_TABLE_CUSTOM_FILENAME="partitions.csv"
CONFIG_PARTITION_TABLE_FILENAME="partitions.csv"

# P4-Function-EV-Board has 16MB flash, but default config uses 2MB.
# Set flash size to 16MB to fit the custom partition table (factory 6M + slave_fw 2M + model 2M).
CONFIG_ESPTOOLPY_FLASHSIZE_16MB=y
CONFIG_ESPTOOLPY_FLASHSIZE="16MB"

# Lower flash frequency for more reliable JTAG flashing
CONFIG_ESPTOOLPY_FLASHFREQ_40M=y
CONFIG_WIFI_CONN_SSID="hbh"
CONFIG_WIFI_CONN_PASSWORD="hbhhbhhbh"

# Audio (ES8311) loopback test disabled for normal operation
CONFIG_AUDIO_ENABLE_LOOPBACK_TEST=n

# Wake word model: 你好小智 (Chinese, WakeNet9s)
CONFIG_SR_WN_WN9S_NIHAOXIAOZHI=y

# PIR motion sensor on GPIO20 (J1 header pin 13)
CONFIG_PIR_SENSOR_ENABLED=y
CONFIG_PIR_SENSOR_GPIO=20

# Use real cloud APIs (Baidu ASR/TTS + Volcano VLM)
CONFIG_CLOUD_API_USE_MOCK=n
CONFIG_CLOUD_API_BAIDU_KEY="Zr82omJTCi5Dgcsgf59N00ZS"
CONFIG_CLOUD_API_BAIDU_SECRET="7mGPzr0uWzQZRDYH0Q1QmAX6xS16TXVk"
CONFIG_CLOUD_API_VOLCANO_KEY="ark-e504e70d-4b7a-4094-987e-f1574be234cc-fa96b"
CONFIG_CLOUD_API_VOLCANO_VLM_MODEL="ep-m-20260708125319-hgz79"

# Doubao TTS (Volcano Engine speech synthesis)
CONFIG_CLOUD_API_TTS_PROVIDER_DOUBAO=y
CONFIG_CLOUD_API_DOUBAO_TTS_APPID="1223567670"
CONFIG_CLOUD_API_DOUBAO_TTS_TOKEN="69a80dda-9794-4ae2-aee4-dfd88a326e38"
CONFIG_CLOUD_API_DOUBAO_TTS_CLUSTER="volcano_tts"
CONFIG_CLOUD_API_DOUBAO_TTS_VOICE="zh_female_sajiaonvyou_moon_bigtts"
CONFIG_CLOUD_API_DOUBAO_TTS_RATE=16000
CONFIG_CLOUD_API_VOLCANO_VLM_MODEL="ep-m-20260708125319-hgz79"

# Increase main task stack: app_main allocates LCD/camera frame buffers and runs init code on it.
CONFIG_ESP_MAIN_TASK_STACK_SIZE=16384

# Move mbedTLS buffers to PSRAM so HTTPS connections (Baidu/Volcano) do not
# exhaust internal RAM after audio/camera allocations.
CONFIG_MBEDTLS_INTERNAL_MEM_ALLOC=n
CONFIG_MBEDTLS_EXTERNAL_MEM_ALLOC=y

# Move ESP-Hosted (C6 SDIO co-processor) task stack and RPC mempool to PSRAM.
CONFIG_ESP_HOSTED_DFLT_TASK_FROM_SPIRAM=y
CONFIG_ESP_HOSTED_MEMPOOL_PREFER_SPIRAM=y

# UI overlay: enable LVGL composited overlay on the live camera preview.
CONFIG_HUMAN_DETECT_TASK_STACK_SIZE=32768
CONFIG_UI_MANAGER_DEMO_ENABLE=n
CONFIG_UI_MANAGER_USE_LVGL=y

# ISP color correction: run one-shot AWB on the first frame to remove
# the SC2336 greenish tint, falling back to a fixed CCM if stats fail.
CONFIG_ISP_AWB_ONESHOT_ENABLE=y

# LVGL minimal configuration for the overlay task.
CONFIG_LV_OS_FREERTOS=y
CONFIG_LV_USE_CLIB_MALLOC=y
CONFIG_LV_USE_CLIB_STRING=y
CONFIG_LV_USE_CLIB_SPRINTF=y
CONFIG_LV_DEF_REFR_PERIOD=16
CONFIG_LV_FONT_SOURCE_HAN_SANS_SC_16_CJK=y
CONFIG_LV_BUILD_EXAMPLES=n
CONFIG_LV_USE_DEMO_WIDGETS=n
CONFIG_LV_USE_DEMO_BENCHMARK=n
CONFIG_LV_USE_DEMO_STRESS=n
CONFIG_LV_USE_DEMO_MUSIC=n
```
